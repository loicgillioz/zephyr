## drivers/gpio/Kconfig.pca953x
```kconfig
# PCA953X GPIO configuration options

# Copyright (c) 2018 Aapo Vienamo
# Copyright (c) 2021 Laird Connectivity
# SPDX-License-Identifier: Apache-2.0

menuconfig GPIO_PCA953X
	bool "PCA953X I2C GPIO chip"
	default y
	depends on DT_HAS_NXP_PCA9539_ENABLED || DT_HAS_NXP_PCA9538_ENABLED || DT_HAS_NXP_PCA9537_ENABLED || DT_HAS_NXP_PCA9536_ENABLED || DT_HAS_NXP_PCA9535_ENABLED || DT_HAS_NXP_PCA9534_ENABLED
	select I2C
	help
	  Enable driver for PCA953X I2C GPIO mux/demux series.

if GPIO_PCA953X

config GPIO_PCA953X_INIT_PRIORITY
	int "Init priority"
	default 70
	help
	  Device driver initialization priority.

endif # GPIO_PCA953X
```

## dts/bindings/gpio/nxp,pca9539.yaml
```yaml
# Binding for NXP PCA9539

description: NXP PCA9539 binding

compatible: "nxp,pca9539"

include: nxp,pca953x-base.yaml

properties:
  ngpios:
    const: 16

child-binding:
  compatible: "nxp,pca9539-gpio"
```

## dts/bindings/gpio/nxp,pca953x-base.yaml
```yaml
# Copyright (c) 2019 Intel Corporation
# SPDX-License-Identifier: Apache-2.0

description: PCA953x series I2C-based GPIO expander

compatible: "nxp,pca953x"

include: [gpio-controller.yaml, i2c-device.yaml]

properties:
  has-pud:
    type: boolean
    description: Supports pull-up/pull-down

  has-interrupt-mask-reg:
    type: boolean
    description: Has Interrupt mask register (PCAL95xx)

  interrupt-gpios:
    type: phandle-array
    description: Interrupt GPIO pin (active-low open-drain)

  "#gpio-cells":
    const: 3

gpio-cells:
  - port
  - pin
  - flags
```
